## base_external/Config.in
```kconfig
source "$BR2_EXTERNAL_assignment_base_PATH/package/aesd-assignments/Config.in"
source "$BR2_EXTERNAL_assignment_base_PATH/package/ldd/Config.in"
```

## base_external/package/ldd/Config.in
```kconfig
config BR2_PACKAGE_LDD
    bool "ldd"
    depends on BR2_LINUX_KERNEL
    help
      Linux Device Drivers examples from the LDD3 book,
      including misc-modules and scull components.
```
